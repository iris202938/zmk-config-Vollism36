#include "Vollism36.dtsi"

&default_transform {
    col-offset = <4>;
};

&kscan0 {
        col-gpios
            = <&xiao_d 10 GPIO_ACTIVE_HIGH>
            , <&xiao_d 9 GPIO_ACTIVE_HIGH>
            , <&xiao_d 8 GPIO_ACTIVE_HIGH>
            , <&gpio1 12 GPIO_ACTIVE_HIGH>
            , <&gpio0 9 GPIO_ACTIVE_HIGH>
            ;
};

/ {
    aliases {
        led-red = &led0;   /* Xiao BLE 本体赤色LED */
        led-green = &led1; /* Xiao BLE 本体緑色LED */
        led-blue = &led2;  /* Xiao BLE 本体青色LED */
    };
};