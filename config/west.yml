## config/west.yml
```yaml
manifest:
  remotes:
    - name: zmkfirmware
      url-base: https://github.com/zmkfirmware
    - name: badjeff
      url-base: https://github.com/badjeff
    - name: sayu-hub
      url-base: https://github.com/sayu-hub
    - name: zettaface
      url-base: https://github.com/zettaface
    - name: iris202938  # <-- led
      url-base: https://github.com/iris202938
    - name: hsgw
      url-base: https://github.com/hsgw
    # - name: eswai
    #   url-base: https://github.com/eswai
  projects:
    - name: zmk
      remote: zmkfirmware
      # revision: main
      revision: v0.3
      import: app/west.yml
    - name: zmk-pmw3610-driver
      remote: sayu-hub
      revision: main
    - name: zmk-input-processor-keybind
      remote: zettaface
      revision: main
    - name: zmk-rgbled-widget
      remote: iris202938
      revision: main
    - name: zmk-feature-sensor_rotation
      remote: hsgw
      revision: main
      path: modules/zmk-feature-sensor_rotation
    - name: zmk-input-processor-report-rate-limit
      remote: badjeff
      revision: main
      path: modules/zmk-input-processor-report-rate-limit
    - name: zmk-naginata
      # remote: eswai
      # revision: main
  self:
    path: config
    
```
